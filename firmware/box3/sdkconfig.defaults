## firmware/box3/sdkconfig.defaults
```kconfig
# Defaults for the ESP32-S3-BOX-3 voice client.
# Apply with: idf.py set-target esp32s3 && idf.py reconfigure

CONFIG_IDF_TARGET="esp32s3"

# ----- Flash -----
CONFIG_ESPTOOLPY_FLASHSIZE_16MB=y
CONFIG_ESPTOOLPY_FLASHMODE_QIO=y
CONFIG_ESPTOOLPY_FLASHFREQ_80M=y
CONFIG_PARTITION_TABLE_CUSTOM=y
CONFIG_PARTITION_TABLE_CUSTOM_FILENAME="partitions.csv"

# ----- PSRAM (the Box-3 has 8 MB octal PSRAM) -----
CONFIG_SPIRAM=y
CONFIG_SPIRAM_MODE_OCT=y
CONFIG_SPIRAM_SPEED_80M=y
CONFIG_SPIRAM_USE_MALLOC=y
CONFIG_SPIRAM_TRY_ALLOCATE_WIFI_LWIP=y
CONFIG_SPIRAM_MALLOC_ALWAYSINTERNAL=16384

# ----- CPU -----
CONFIG_ESP_DEFAULT_CPU_FREQ_MHZ_240=y
CONFIG_FREERTOS_HZ=1000

# ----- Logging -----
CONFIG_LOG_DEFAULT_LEVEL_INFO=y
CONFIG_LOG_COLORS=y

# ----- LWIP / network -----
CONFIG_LWIP_MAX_SOCKETS=16

# ----- mbedTLS (needed by DTLS-SRTP in WebRTC) -----
CONFIG_MBEDTLS_HARDWARE_AES=y
CONFIG_MBEDTLS_HARDWARE_SHA=y
CONFIG_MBEDTLS_DTLS_CLIENT=y
CONFIG_MBEDTLS_SSL_PROTO_DTLS=y
CONFIG_MBEDTLS_SSL_DTLS_SRTP=y

# ----- esp-sr / AFE -----
# Use the v1 multi-mic SR AFE pipeline (beamforming + AEC + NS + AGC).
# WakeNet is disabled; wake-word detection is microWakeWord, not WakeNet.
CONFIG_USE_AFE=y
CONFIG_AFE_INTERFACE_V1=y
CONFIG_USE_WAKENET=n

# ----- LVGL (display) -----
CONFIG_LV_COLOR_DEPTH_16=y
CONFIG_LV_USE_PERF_MONITOR=n
```
